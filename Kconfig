## Kconfig
```kconfig
# SPDX-License-Identifier: Apache-2.0
#
# zmk-module-bmp-extender-lcd

config LS0XX_SWVCOM
    bool "Sharp LS0xx memory display driver with software VCOM toggling"
    default y
    depends on DT_HAS_SHARP_LS0XX_SWVCOM_ENABLED
    depends on DISPLAY
    help
      Sharp MIP display driver based on Zephyr's ls0xx, adding periodic
      software VCOM inversion via the serial command V bit for wirings
      without an EXTCOMIN line.

config LS0XX_SWVCOM_HEAL_REFRESH_MS
    int "Self-healing periodic full-panel refresh interval (ms) for the rotated MIP driver, 0 to disable"
    default 2000
    depends on LS0XX_SWVCOM
    help
      Real-hardware feedback (2026-08-05, tecla-cero) showed random
      speckle/streak corruption accumulating in the panel's own bistable
      pixel memory while the BLE host was out of range -- suspected
      external causes are voltage sag on an out-of-spec supply rail
      during advertising radio current spikes, and/or 2.4GHz EMI coupling
      into jumper wiring (see README.md, "制約・注意点"). The row-level
      dirty-diff sender in the
      driver only re-sends rows whose *intended* content changed, so it
      cannot detect or fix corruption that happens outside its control;
      before the diff sender existed, frequent full-panel redraws
      happened to paper over the corruption on every unrelated redraw,
      which is what read as "flicker". This makes the driver blind-resend
      its shadow framebuffer (known-good content) to the whole panel on a
      periodic timer, self-healing any corruption within one interval
      regardless of whether LVGL thinks anything changed. Firmware cannot
      fix the underlying electrical cause; this only bounds how long
      corruption can persist. Only effective when the driver's rotation
      is enabled (the shadow framebuffer this reads from only exists on
      that path); the driver guards the whole feature with
      `#if LS0XX_ROTATION != 0`, so in rotation=0 builds this symbol
      compiles to nothing regardless of its value. Set to 0 to disable.
      The extra ~12ms SPI transfer every interval is negligible next to
      typical values (the display has no continuous animation); the
      timer's own device is unaffected by ZMK_SLEEP/System OFF since
      ext-power is cut first.

config LS0XX_SWVCOM_INIT_FILL_BLACK
    bool "Send an all-black fill instead of CLEAR on driver init"
    default n
    depends on LS0XX_SWVCOM
    help
      At driver init, send an all-rows black (ink) fill instead of the
      usual white CLEAR command. Useful when the application's first
      frame is black (e.g. a boot splash), so the retained
      previous-session image (Sharp MIP panels keep the last written
      image on their bistable pixel memory across power cycles) cuts
      straight to black with no white blink in between. Only effective
      when the driver's rotation is enabled (the shadow-framebuffer path);
      writing all rows pins every pixel to a known state exactly like
      CLEAR would, so this is a drop-in replacement for that
      initialization step.
```

## dts/bindings/display/sharp,ls0xx-swvcom.yaml
```yaml
# Sharp メモリ液晶 (LS0xx 系) — ソフトウェア VCOM 反転版
# EXTCOMIN が配線されていない構成 (beekeeb ブレイクアウト 5P 等) 向け。
# シリアルコマンドの V ビットを周期反転して DC バイアスを防ぐ

description: Sharp memory display controller with software VCOM toggling

compatible: "sharp,ls0xx-swvcom"

include: [spi-device.yaml, display-controller.yaml]

properties:
  vcom-period-ms:
    type: int
    default: 34
    description: |
      VCOM 極性反転の全周期 [ms]。半周期ごとに V ビットをトグルする。
      LS011B7DH03 の仕様は COM 周波数 約30Hz (極性切替 約17ms ごと) のため
      デフォルト 34ms (半周期 17ms ≈ 58.8Hz 切替 = 仕様内)。
      本ドライバは単一インスタンス前提 (DT_INST 0 のみ)

  disp-en-gpios:
    type: phandle-array
    description: |
      DISPLAY enable ピン (配線されている場合のみ)

  rotation:
    type: int
    default: 0
    enum:
      - 0
      - 90
      - 270
    description: |
      パネル物理座標系 (width/height プロパティ、常に 160x68 のまま) に対する
      論理表示の回転角度 (時計回り, 度)。Zephyr v4.1 の LVGL グルー
      (modules/lvgl/lvgl.c, lvgl_display_mono.c) に回転サポートが無いため、
      本ドライバの write()/get_capabilities() 内で独自に回転を実装する
      (詳細は drivers/display/ls0xx_swvcom.c 冒頭コメントと README.md 参照)。

      0 (既定): 無回転。既存の実機検証済み経路を一切変更しない
      (ゼロオーバーヘッド)。

      90/270: get_capabilities() が論理解像度 72x160 を advertise する
      (パネル高さ 68 は 8 の倍数でないため 8 の倍数へ切り上げた 72 を使い、
      68〜71 列はデッドカラムとして write() 側で読み捨てる。lvgl.c の
      1bpp パック処理 (x/8 + y*width/8 という整数演算) が width を 8 の倍数
      と仮定しているため、68 を直接 advertise すると行毎に半バイトずれて
      破綻する)。write() は受け取った論理座標の MONO01 バッファをビット
      転置し、パネル空間のシャドウバッファへ書いてから既存の
      ls0xx_update_display() でパネル全68行を送信する。

      90 = 論理内容を時計回りに90°回して表示、270 =反時計回り
      (=時計回り270°)。実機で天地/左右が逆であれば 90⇔270 を入れ替える
      だけでよい。(2026-08-03 codex レビュー P1: 初版はこの説明と実装の式が
      逆だったため修正。正しい式は drivers/display/ls0xx_swvcom.c の
      ls0xx_transpose_into_shadow() 冒頭コメント参照)

      180 は現状未実装 (コスト対効果が低いため enum から除外。用途は
      縦表示 (90/270) であり、180 は単なる天地逆さの横表示にしかならない。
      詳細は tecla-cero キーボードリポジトリの DESIGN.md)。
```
